// generated by mBlock5 for mBot
// codes make you happy

/*
	--todo--
	--> matlib mat_vec multiplication kontrollieren. generell cg kontrollieren
	--> kreis fit mit cg solver und newton linearisierung
*/

#include <MeMCore.h>
#include <Arduino.h>
#include <Wire.h>
#include <SoftwareSerial.h>
#include <cmath.h>
#include <vector>
#include <matlib.h>

MeLightSensor lightsensor_6(6);
MeDCMotor motor_9(9);
MeDCMotor motor_10(10);
MeLineFollower linefollower_2(2);
MeUltrasonicSensor ultrasonic_3(3);
double currentTime = 0;
double lastTime = 0;
MeIR ir;
MeLEDMatrix ledMtx_1(1);

float k = 0;
const double PI = 3.14159;

static struct move_param{
	int forward = 1;
	int backward = 2;
	int turnLeft = 3;
	int turnRight =4;
	int speed=255;
	int engine_speed_coeff = 0; // engine_s_c = n/speed
	float diameter = 0;
	float wheelbase = 0;
};

static struct coordinate{
	float x=0;
	float y=0;
	float phi = 0; //start in x
};

static struct _time{
	float time_start = 0;
	float time_end = 0;
};

static enum class STATE{
	TRANSLATION;
	TURNING_LEFT,
	TURNING_RIGHT,
	FINISHED_CIRCUM,
	FINISHED_ROTATION_MIDDLE,
	FINISHED_MOVEMENT_MIDDLE,
}

bool second_part = false;

//-----vars------
STATE bot_state = STATE::TRANSLATION;
STATE last_bot_state;

coordinate bot_coord;
move_param bot_param;
_time rotation_time;
_time translation_time;

float sensorValue = 0;
std::vector<coordinate> coord_list;
coordinate start_coord;
int phi = 2;
bool firstCheck = false;
int lastDir = bot_param.turnRight;
std::string lastDirection = "LEFT";
float timeVal = 0;
bool is_turnig = false;
bool circum_check = false;


//-vars drive middle
float cchecked_phi = 0;
bool rot_90_check = false;
float middle_time = 0;
bool middle_check = false;
float middle_x = 0;
float middle_y = 0;
float fitted_r = 0;
float face = 0;

void move(const int dir, int speed) {
  int leftSpeed = 0;
  int rightSpeed = 0;
  if(dir == 1) {
    leftSpeed = speed;
    rightSpeed = speed;
  } else if(dir == 2) {
    leftSpeed = -speed;
    rightSpeed = -speed;
  } else if(dir == 3) {
    leftSpeed = -speed;
    rightSpeed = speed;
  } else if(dir == 4) {
    leftSpeed = speed;
    rightSpeed = -speed;
  }
  motor_9.run((9) == M1 ? -(leftSpeed) : (leftSpeed));
  motor_10.run((10) == M1 ? -(rightSpeed) : (rightSpeed));
}


void _delay(float seconds, move_param& param, coordinate& coord, bool CoordUpdate) {
  long endTime = millis() + seconds * 1000;
  while(millis() < endTime) _loop();
	//update coord
	if(CoordUpdate){
		coord.x += 2*PI*param.speed*param.engine_speed_coeff*seconds*std::cos(coord.phi)*(param.diameter/2);// s = v*t = 2pi n * t
		coord.y += 2*PI*param.speed*param.engine_speed_coeff*seconds*std::sin(coord.phi)*(param.diameter/2);
	}
}

// for v2.1
void rotate_bot(move_param &param, coordinate & coord, float phi){ // phi in grad
	coord.phi += phi;
	float theta = phi*(PI/180);
	float t = (param.wheelbase*theta)/(param.speed*param.engine_speed_coeff*2*PI*(param.diameter/2)); // t = wb*theta/n*2*pi*r
	if(phi>0){
		move(param.turnLeft, param.speed);
	}if(phi<0){
		move(param.turnRight, param.speed);
	}
	_delay(t, param, coord, false);

}

//for v2.2
void rotate_bot_undefined(move_param &param, std::string direction){ // phi in grad
	if(direction == "LEFT"){
		move(param.turnLeft, param.speed);
	}else if(direction == "RIGHT"){
		move(param.turnRight, param.speed);
	}else{
		return 0;
	}

}

void addCoordRot(move_param &param, coordinate& coord, _time &tc){
	float t = (tc.time_end-tc.time_start)/1000;
	float phi_ = (t *  param.speed * param.engine_speed_coeff * param.diameter)/ param.wheelbase; //in rad
	coord.phi += phi_;
}

void addCoordTrans(move_param &param, coordinate& coord, _time &tc, std::vector<float> &list){
	float t = (tc.time_end-tc.time_start)/1000;
	float delta = PI*param.diameter*param.speed* param.engine_speed_coeff*t;//v = 2pirn - v = s/t --> s = v*t = 2pirn*t
	float delta_x = delta*std::cos(coord.phi);
	float delta_y = delta*std::sin(coord.phi);
	coord.x += delta_x; // 
	coord.y += delta_y;
	list.push_back(coord)
}

bool circumCheck(std::vector<coordinat> &coordlist, std::string circumdir){ //richtungsabhängig ?
	int ignore_num = 2;
	for(int i=0;i<coordlist.size;i++){
		if(i>ignore_num){
			if(coordlist[i].x<=coordlist[0].x && coordlist[i].x>=coordlist[ignore_num].x){
				if(circumdir=="RIGHT"){
					if(coordlist[i].y<=coordlist[0].y){
						return true;
					}
				}else{
					if(coordlist[i].y>=coordlist[0].y){
						return true;
					}
				}
			}
		}
	}
}

double getLastTime(){
  return currentTime = millis() / 1000.0 - lastTime;
}


//------mathematic stuff--------
matlib::Matrix getCoordinateVec(const std::vector<coordinate> &coord_list){
	matlib::Matrix res;
	res.nrows = coord_list.size();
	res.ncols = 2;
	for (int i=0;i<coord_list.size();i++){
		res(i,0) = coord_list[i].x;
		res(i,1) = coord_list[i].y;
	}
	return res;
}
std::vector<double> getResidualVec(const matlib::Matrix &coord_vec, const float &empty_xc, const float &empty_yc, const float &r){ //estimation of circle
	int n = coord_vec.row_size();
	std::vector<double> res(n,0);
	for (int i=0;i<n;i++){
		res[i]=(coord_vec(i,0)-empty_xc)*(coord_vec(i,0)-empty_xc)+(coord_vec(i,1)-empty_yc)*(coord_vec(i,1)-empty_yc)-(r*r);
	}
	return res;
}

matlib::Matrix getJacobiMatrix(const matlib::Matrix &coords, const float& xc, const float& yc, const float &r){ //fehler: r=(x,y) --> dri/dx, dri/dy, dri/dr
	int n = coords.row_size();
	matlib::Matrix res;
	res.ncols = 3;
	res.nrows = n; 
	for (int i = 0;i<n;i++){
		res(i,0) = -2*(coords(i,0)-xc);
		res(i,1) = -2*(coords(i,1)-yc);
		res(i,2) = -2*r;
	}
	return res;
}

void optimizeSystem(const matlib::Matrix &JacobiMat, const std::vector<double> &residual, std::vector<double> &delta, const float convergence = 1e-9){
	delta[0]=0;
	delta[1]=0;
	delta[2]=0;
	matlib::Matrix T_J = JacobiMat;
	matlib::transpose(T_J);

	matlib::Matrix A = matlib::symm_mat_multiplication(T_J, JacobiMat);

	// b = -J^T r
	std::vector<double> b = mat_vec_multiplication(T_J.getVec(), residual);
	for (auto &v : b) v *= -1;

	// delta initial guess
	matlib::AUTO_linsolve_CG(A, b, delta, convergence, false);
}

float r_circularFit(const float convergence, const std::vector<coordinate> &coord_list){
	float lampda = 1; // nur ändern falls numerisch instabil!!! dann: lampda<1
	float xc = 0;
	float yc = 0;
	float r = 0;
	float norm = 1; // damit in schleife geht
	int iter = 0;
	std::vector<double> delta(3,0);
	matlib::Matrix coord_vec = getCoordinateVec(coord_list);

	//initial guess
	int n = coord_vec.row_size();
	float xsum = 0;
	float ysum = 0;
	float rsum = 0;
	for (int i=0;i<n;i++){
		xsum+=coord_vec(i,0);
		ysum+=coord_vec(i,1);
	}
	xc = xsum/n;  
	yc = ysum/n; 
	for (int i=0;i<n;i++){
		rsum+=std::sqrt((coord_vec(i,0)-xc)*(coord_vec(i,0)-xc)+(coord_vec(i,1)-yc)*(coord_vec(i,1)-yc));
	} 
	r = rsum/n;   

	//newton gauss
	while (norm >= convergence*convergence){
		if(iter>10000){
			break;
		}
		std::vector<double> residual = getResidualVec(coord_vec, xc, yc, r);
		matlib::Matrix J = getJacobiMatrix(coord_vec, xc, yc, r);
		optimizeSystem(J, residual,delta);
		xc += lampda*delta[0];
		yc+= lampda*delta[1];
		r+=lampda*delta[2]; 
		norm = (delta[0]*delta[0])+(delta[1]*delta[1])+(delta[2]*delta[2]);
		iter++;
	}
	return r;

}

void setup() {
  ir.begin();
  ledMtx_1.setColorIndex(1);
  ledMtx_1.setBrightness(6);
  coord_list.push_back(start_coord); // coord where first turn is starting

  
}

/*
---------------------------v2.1-----------------------------------

void _v1_loop() {
		//check distance
		
		if (linefollower_2.readSensors() == 2.000000){ //right side dark
				if(!firstCheck){		//defines start of circum
						firstCheck = true;
				}
				rotate_bot(bot_param, bot_coord, phi);
				lastDir = 1;
		}
		if (linefollower_2.readSensors() == 1.000000){ //left side dark
				if(!firstCheck){		
						firstCheck = true;
				}
				rotate_bot(bot_param, bot_coord, -phi);
				lastDir = -1;
		}
		if (linefollower_2.readSensors() == 3.000000){ //both are dark
				if(!firstCheck){		
						firstCheck = true;
				}
				rotate_bot(bot_param, bot_coord, lastDir*phi);
		}
		move(bot_param.forward, bot_param.speed)			
}
*/
/*
---------------------------v2.2-----------------------------------

void _loop() {
	if (!circum_check){
		//check distance	--> maybe black always between sensors
		if (linefollower_2.readSensors() == 2.000000){ //right side dark
			if (!is_turnig){
				translation_time.time_end = millis();
				addCoordTrans(bot_param, bot_coord, translation_time, coord_list)
				rotation_time.time_start = millis();
				rotate_bot_undefined(bot_param, "LEFT");
				is_turnig = true;
			}
			lastDirection = "LEFT";
		}
		else if (linefollower_2.readSensors() == 1.000000){ //left side dark
			if (!is_turnig){
				translation_time.time_end = millis();
				addCoordTrans(bot_param, bot_coord, translation_time, coord_list)
				rotation_time.time_start = millis();
				rotate_bot_undefined(bot_param, "RIGHT");
				is_turnig = true;
			}
			lastDirection = "RIGHT";
		}
		else if (linefollower_2.readSensors() == 3.000000){ //both are dark
			if (!is_turnig){
				translation_time.time_end = millis();
				addCoordTrans(bot_param, bot_coord, translation_time, coord_list)
				rotation_time.time_start = millis();
				rotate_bot_undefined(bot_param, lastDirection);
				is_turnig = true;
			}

		}else {
			is_turnig = false;
			rotation_time.time_end = millis();
			addCoordRot(bot_param, bot_coord, rotation_time);
			translation_time.time_start = millis();
			move(bot_param.forward, bot_param.speed);			
		}
	}
	circum_check = circumCheck(coord_list, lastDirection);
	if (bot_coord.phi >=2*PI){ // bedingun funktioniert nicht
		circum_check = true;
		cchecked_phi = bot_coord.phi; //obsoled --> gedacht falls rotate_bot_undefined verwendet wird
		//... corner fit
		//... calc
		//... set middle points
		//... show
		//mabe multiple rounds
	}
	//driving back to middle
	if(circum_check){ //move_param &param, coordinate & coord, float phi
		if (!rot_90_check){ // drehung in mitte
			rot_90_check = true;
			if lastDirection == "LEFT"{ //richtige 90 grad bekommen
				rotate_bot(bot_param, bot_coord, 90);
			}else{
				rotate_bot(bot_param, bot_coord, -90);
			}
		}else if(!middle_check){
			middle_check = true;
			//										speed									  /							hypothenuse --> nearly x-x_middle
			middle_time = (bot_param.speed*bot_param.engine_speed_coeff*PI*bot_param.diameter)/std::sqrt((bot_coord.x - middle_x)*(bot_coord.x - middle_x)+(bot_coord.y-delta_y)*(bot_coord.y-delta_y))
			move(bot_param.forward, bot_param.speed)
			_delay(middle_time)
		}else{
			//--> steht im mittelpunkt ...fläche anzeige
		}
	}
}

*/
/*
---------------------------v2.3----------------------------------- --> enum version
*/
void _loop() {
	//read sensor
	sensorValue = linefollower_2.readSensors();
	//set states
	//line following
	if(bot_state == STATE::TRANSLATION){
		if (sensorValue == 2.000000){ //right side dark
			bot_state = STATE::TURNING_LEFT;
		}
		else if (sensorValue == 1.000000){ //right side dark
			bot_state = STATE::TURNING_RIGHT;
		}
		else if (sensorValue == 3.000000){ //right side dark
			if(last_bot_state == STATE::TURNING_LEFT){
				bot_state = STATE::TURNING_LEFT;
			}else if(last_bot_state == STATE::TURNING_RIGHT){
				bot_state = STATE::TURNING_RIGHT;
			}else{
			bot_state = STATE::TURNING_LEFT; //begin cornering
			}
		}
	}

	//finishing
	if(!second_part && circumCheck(coord_list, STATE::TURNING_LEFT)){
		bot_state = STATE::FINISHED_CIRCUM;
		second_part = true;
	}

	/////>>>>>>>>>>>>>würde ich gerne mal testen<<<<<<<<<<<<<</////////////////

	/*if(bot_state == STATE::TURNING_LEFT || bot_state == STATE::TURNING_RIGHT){
		if(sensorValue == 0){ //no dark 
			bot_state = STATE::TRANSLATION;
		}
	}*/

	//exec state
	switch(bot_state){
		case STATE::TURNING_LEFT:
			if(bot_state != last_bot_state){
				translation_time.time_end = millis();
				addCoordTrans(bot_param, bot_coord, translation_time, coord_list)
				rotation_time.time_start = millis();
			}
			rotate_bot_undefined(bot_param, "LEFT");
			lastDirection = "LEFT";

			//exit hier weil chatGPT das sagt
			sensorValue = linefollower_2.readSensors();
			if(sensorValue == 0){ //no dark 
				bot_state = STATE::TRANSLATION;
			}
			break;

		case STATE::TURNING_RIGHT:
			if(bot_state != last_bot_state){
				translation_time.time_end = millis();
				addCoordTrans(bot_param, bot_coord, translation_time, coord_list)
				rotation_time.time_start = millis();
			}
			rotate_bot_undefined(bot_param, "RIGHT");
			lastDirection = "RIGHT";
			
			//exit
			sensorValue = linefollower_2.readSensors();
			if(sensorValue == 0){ //no dark 
				bot_state = STATE::TRANSLATION;
			}
			break;
		
		case STATE::TRANSLATION:
			if(bot_state != last_bot_state){
				rotation_time.time_end = millis();
				addCoordRot(bot_param, bot_coord, rotation_time);
				translation_time.time_start = millis();
			}
			move(bot_param.forward, bot_param.speed);
			break;

		case STATE::FINISHED_CIRCUM:
			fitted_r = r_circularFit(coord_list);
			face = pi*fitted_r*fitted_r;
			middle_x = -fitted_r; //davon ausgehend, dass startpunkt 0,0 ist
			middle_y = 0;
			//... show calculating
			//mabe multiple rounds
			if lastDirection == "LEFT"{ //richtige 90 grad bekommen
				rotate_bot(bot_param, bot_coord, 90);
			}else{
				rotate_bot(bot_param, bot_coord, -90);
			}
			bot_state = STATE::FINISHED_ROTATION_MIDDLE;
			break;

		case STATE::FINISHED_ROTATION_MIDDLE:
			//										speed									  /							hypothenuse --> nearly x-x_middle
			middle_time = (bot_param.speed*bot_param.engine_speed_coeff*PI*bot_param.diameter)/std::sqrt((bot_coord.x - middle_x)*(bot_coord.x - middle_x)+(bot_coord.y-delta_y)*(bot_coord.y-delta_y));
			move(bot_param.forward, bot_param.speed);
			_delay(middle_time);
			bot_state = STATE::FINISHED_MOVEMENT_MIDDLE;
			break;
		
		case STATE::FINISHED_MOVEMENT_MIDDLE:
			//print result

	}
	last_bot_state = bot_state;

}


void loop() {
  _loop();
}

